/*********************************************************************

  X-Wing vs Death Star game for WEMOS D1 ESP-WROOM-02 / ESP8266

  Version 0.1

  For more information, see:
  https://oneguyoneblog.com/2020/01/30/star-wars-game-on-esp8266-with-esp-wroom-02/

  Original project:
  https://www.youtube.com/watch?v=lOz_GuME63E

*********************************************************************/


#include "SSD1306Brzo.h"            // Include OLED Library

SSD1306Brzo  display(0x3c, 5, 4);   // Initialize OLED display

int blueLed = LED_BUILTIN;          // Blue LED is on GPIO 2 (LED_BUILTIN)
int greenLed = 16;                  // Green LED is on GPIO 16

const byte switchedOff = HIGH;
const byte switchedOn = LOW;
byte ledState = LOW;

int buzzerPin = 15;                 // buzzer connected to gpio 15 = pin D8 on the pinheader

const int buttonRight = 0;          // button right = gpio 0
const int buttonDown = 12;          // button down  = gpio 12
const int buttonUp = 13;            // button up    = gpio 12
const int buttonPush = 14;          // button push  = gpio 14

const unsigned char PROGMEM xWingGFX [] = {
  0xFC, 0x07, 0x38, 0x00, 0x3C, 0x00, 0x7F, 0x00, 0xFC, 0x01, 0x7E, 0xFE,
  0x7E, 0xFE, 0xFC, 0x01, 0x7F, 0x00, 0x3C, 0x00, 0x38, 0x00, 0xFC, 0x07,
};

const unsigned char PROGMEM titleScreenGFX [] = {
  0x84, 0x59, 0x02, 0x00, 0x00, 0x88, 0x40, 0x40, 0xF8, 0xC8, 0x01, 0xF0,
  0x3F, 0x00, 0x94, 0xD0, 0x04, 0x10, 0x00, 0xF0, 0x00, 0x00, 0x84, 0xF8,
  0xFF, 0xFF, 0xFF, 0x3F, 0x60, 0x23, 0x11, 0x80, 0x00, 0x00, 0xC0, 0xFF,
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  0xFF, 0xFF, 0x1F, 0x21,
};

const unsigned char PROGMEM gameOverGFX [] = {
  0x00, 0x00, 0x00, 0x00, 0x00, 0x00, 0x00, 0x00, 0x00, 0x80, 0x00, 0x00,
  0x00, 0x00, 0x00, 0x00, 0x00, 0x10, 0x00, 0x10, 0x0A, 0x00, 0x00, 0x00,
  0x00, 0x00, 0x00, 0x00, 0x00, 0x00, 0x00, 0x80, 0x00, 0x00, 0x00, 0x20,
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  0x00, 0x00, 0x00, 0x00,
};

const unsigned char PROGMEM scoreBoardGFX [] = {
  0x00, 0xFE, 0xFE, 0x00, 0x00, 0x00, 0x00, 0x00, 0x00, 0x00, 0x00, 0x00,
  0x00, 0x00, 0x00, 0x00, 0x00, 0xFF, 0xFF, 0x01, 0x00, 0x00, 0x00, 0x00,
  0x00, 0x00, 0x00, 0x00, 0x00, 0x00, 0x00, 0x00, 0x80, 0x83, 0x83, 0x03,
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  0x00, 0x00, 0x00, 0x00,
};

int starX[] = {50, 30, 60, 55, 25, 100, 117, 14, 24, 78, 80, 107, 150, 5, 8, 70, 10, 70};
int starY[] = {30, 17, 18, 16, 43, 43, 52, 49, 24, 36, 57, 11, 11, 5, 7, 12, 56, 25};
int starSpeed[] = {1, 2, 3, 4, 1, 2, 3, 4, 1, 2, 3, 4, 1, 2, 3, 4, 1, 2};

int blinky = true;
bool blinkXwing = false;
int blinkCycleXwing = 0;
int blinkXwingcounter = 0;
bool blinkDeathstar = false;
int blinkDeathstarcounter = 0;

void setup()   {

  pinMode(buttonRight,  INPUT_PULLUP);  // button right
  pinMode(buttonDown,   INPUT_PULLUP);  // button down
  pinMode(buttonUp,     INPUT_PULLUP);  // button up
  pinMode(buttonPush,   INPUT_PULLUP);  // button push

  pinMode(blueLed,  OUTPUT);   // Initialize digital pin LED_BUILTIN as an output.
  pinMode(greenLed, OUTPUT);  // initialize digital pin 16 as an output.

  display.init();   // Initialise the display
  display.clear();  // Clear OLED display

  display.drawXbm(0, 0, 128, 64, titleScreenGFX); // draw title screen
  display.display();

  playTune(); // play Star Wars tune on the buzzer

  waitButton(); // wait for button press while fading LEDs
}

int laserX = 0;
int laserY = 0;
int laserFired = 0;
int nep = 8;
int direction = 0;
int gameOver = 0;
int bulletX = 95;
int bulletY = 0;
int bulletX2 = 95;
int bulletY2 = 0;
int bulletX3 = 95;
int bulletY3 = 0;
int bulletX4 = 95;
int bulletY4 = 0;
int points = 0;

int bulletSpeed = 3;
int bkugle = 1;
int smallest = 600;
int largest = 1200;
int diameter = 10;
int lives = 5;
int poc = 0;
int bulletFired = 0;
int level = 1;
int center = 95;
unsigned long startTime = 0;
unsigned long selectTime = 0;
unsigned long currentTime = 0;
unsigned long starttime2 = 0;
unsigned long endtime = 0;
unsigned long duration = 0;
unsigned long levelTime = 0;
int poz = 30;
bool newround = true;

void loop() {

  if (gameOver == 0) {
    display.clear();

    if (newround == true) {
      starttime2 = millis();
      currentTime = millis();
      newround = false;
    }

    for (int i = 0; i <= 17; i++) {
      starX[i] = starX[i] - (starSpeed[i] );
      if (starX[i] <= 0) {
        starSpeed[i] = random (1, 4);
        starX[i] = 128 + (starSpeed[i]);
      }
      display.setPixel(starX[i], starY[i]);
    }

    if (poc == 0) {
      startTime = millis();
      selectTime = random(400, 1200);
      poc = 1;
    }
    currentTime = millis();

    //nivoi

    if ((currentTime  - levelTime) > 50000)
    {
      levelTime = currentTime;
      level = level + 1;
      bulletSpeed = bulletSpeed + 1; //brizna neprijateljevog metka
      if ( level % 2 == 0 )
      {
        bkugle = bkugle + 1;
        diameter = diameter - 1;
      }
      smallest = smallest - 50;
      largest = largest - 50;
    }

    if ((selectTime + startTime) < currentTime)
    {
      poc = 0;
      bulletFired = bulletFired + 1;
      tone(buzzerPin, 300, 20);
      if (bulletFired == 1)
      { bulletX = 95;
        bulletY = nep;
      }
      if (bulletFired == 2) {
        bulletX2 = 95;
        bulletY2 = nep;
      }
      if (bulletFired == 3)
      {
        bulletX3 = 95;
        bulletY3 = nep;
      }
      if (bulletFired == 4) {
        bulletX4 = 95;
        bulletY4 = nep;
      }
    }

    if (blinky == true) {
      display.setColor(WHITE);
      blinky = false;
    } else {
      display.setColor(BLACK);
      blinky = true;
    }

    if (bulletFired > 0)
    {
      display.fillCircle(bulletX, bulletY, 2);
      bulletX = bulletX - bulletSpeed;
    }
    if (bulletFired > 1)
    {
      display.fillCircle(bulletX2, bulletY2, 3);
      bulletX2 = bulletX2 - bulletSpeed;
    }
    if (bulletFired > 2)
    {
      display.fillCircle(bulletX3, bulletY3, 4);
      bulletX3 = bulletX3 - bulletSpeed;
    }
    if (bulletFired > 3)
    {
      display.fillCircle(bulletX4, bulletY4, 2);
      bulletX4 = bulletX4 - bulletSpeed;
    }

    display.setColor(WHITE);

    if (digitalRead(buttonUp) == 0 && poz >= 2) { // button up
      poz = poz - 2;
    }

    if (digitalRead(buttonDown) == 0 && poz <= 48) { // button down
      poz = poz + 2;
    }

    if ((digitalRead(buttonPush) == 0 || digitalRead(buttonRight) == 0) && laserFired == 0) // button push or right
    {
      laserFired = 1;
      laserX = 6;
      laserY = poz + 8;
      tone(buzzerPin, 1200, 20);
    }
    if (laserFired == 1)
    {
      laserX = laserX + 8 ;
      display.drawLine(laserX, laserY, laserX + 4, laserY);
    }

    if (blinkXwingcounter > 0) {
      blinkXwingcounter--;
      tone(buzzerPin, 1000 - (blinkXwingcounter * 50), 20);
      blinkCycleXwing++;
      if (blinkCycleXwing == 3) {
        blinkCycleXwing = 0;
        if (blinkXwing == true) {
          blinkXwing = false;
          display.setColor(BLACK);
          ledsOff();
          delay(10);
        } else {
          display.setColor(WHITE);
          ledsOff();
          blinkXwing = true;
        }
      }
    } else {
      display.setColor(WHITE);
      ledsOn();
    }

    display.drawXbm(4, poz + 2, 16, 12, xWingGFX);

    if (blinkDeathstarcounter > 0) {
      blinkDeathstarcounter--;
      if (blinkDeathstar == true) {
        blinkDeathstar = false;
        display.setColor(BLACK);
        ledsOff();
        tone(buzzerPin, 500 + (blinkDeathstarcounter * 50), 20);
      } else {
        display.setColor(WHITE);
        blinkDeathstar = true;
        ledBlueOn();
        tone(buzzerPin, 500 + (blinkDeathstarcounter * 50), 20);
      }
    } else {
      display.setColor(WHITE);
      ledsOn();
    }

    display.fillCircle(center, nep, diameter);
    display.setColor(BLACK);
    display.fillCircle(center + 2, nep - 3, diameter / 2.5);
    display.setColor(WHITE);
    display.setPixel(center + 1, nep - 2);

    display.setColor(WHITE);
    display.setFont(ArialMT_Plain_10);
    display.setTextAlignment(TEXT_ALIGN_LEFT);

    display.drawString(23, 54, "Score");
    String score = String(points);
    display.drawString(58, 54, score);

    display.drawString(23, 0, "Lives:");
    String livesLeft = String(lives);
    display.drawString(58, 0, livesLeft);

    display.drawString(77, 0, "Level:");
    String levelNow = String(level);
    display.drawString(108, 0, levelNow);

    display.drawString(77, 54, "Time:");
    duration = (millis() - starttime2) / 1000;
    String elapsed = String(duration);
    display.drawString(108, 54, elapsed);

    display.display();

    if (laserX > 128)laserFired = 0;

    if (direction == 0) {
      nep = nep + bkugle;
    }
    else
    {
      nep = nep - bkugle;
    }

    if (nep >= (64 - diameter))
      direction = 1;
    if (nep <= diameter)
      direction = 0;

    if (laserY >= nep - diameter && laserY <= nep + diameter)
      if (laserX > (center - diameter) && laserX < (center + diameter))
      {
        laserX = -20;
        tone(buzzerPin, 500, 100);
        points = points + 1;
        laserFired = 0;
        blinkDeathstarcounter = 10;
      }

    int pozicija = poz + 8;
    if (bulletY >= pozicija - 8 && bulletY <= pozicija + 8)
      if (bulletX < 12 && bulletX > 4)
      {
        bulletX = 95; // ???????
        bulletY = -50;
        tone(buzzerPin, 100, 100);
        lives = lives - 1;
        blinkXwingcounter = 30;
      }

    if (bulletY2 >= pozicija - 8 && bulletY2 <= pozicija + 8)
      if (bulletX2 < 12 && bulletX2 > 4)
      {
        bulletX2 = -50;
        bulletY2 = -50;
        tone(buzzerPin, 100, 100);
        lives = lives - 1;
        blinkXwingcounter = 30;
      }

    if (bulletY3 >= pozicija - 8 && bulletY3 <= pozicija + 8)
      if (bulletX3 < 12 && bulletX3 > 4)
      {
        bulletX3 = -50;
        bulletY3 = -50;
        tone(buzzerPin, 100, 100);
        lives = lives - 1;
        blinkXwingcounter = 30;
      }

    if (bulletY4 >= pozicija - 8 && bulletY4 <= pozicija + 8)
      if (bulletX4 < 12 && bulletX4 > 4)
      {
        bulletX4 = -50;
        bulletY4 = -50;
        bulletFired = 0;
        tone(buzzerPin, 100, 100);
        lives = lives - 1;
        blinkXwingcounter = 30;
      }

    if (bulletX4 < 1) {
      bulletFired = 0;
      bulletX4 = 200;
    }

    if (lives == 0)
      gameOver = 1;
  }

  if (gameOver == 1)
  {
    if (lives == 0) {
      endtime = millis();
      display.invertDisplay();
      ledsOn();
      tone(buzzerPin, 200, 300);
      delay(300);
      display.normalDisplay();
      ledsOff();
      tone(buzzerPin, 250, 200);
      delay(200);
      tone(buzzerPin, 300, 300);
      display.invertDisplay();
      ledsOn();
      delay(300);
      lives = 5;
      display.normalDisplay();
      ledsOff();
    }

    display.clear();
    display.drawXbm(0, 0, 128, 64, gameOverGFX);
    display.display();
    delay(3000);

    display.clear();
    display.drawXbm(0, 0, 128, 64, scoreBoardGFX);

    display.setColor(WHITE);
    display.setTextAlignment(TEXT_ALIGN_CENTER);
    display.setFont(ArialMT_Plain_10);

    display.drawString(32, 23, "Score:");
    display.drawString(64, 23, "Level:");
    display.drawString(96, 23, "Time:");

    display.setFont(ArialMT_Plain_16);

    String score = String(points);
    display.drawString(32, 33, score);

    String levelReached = String(level);
    display.drawString(64, 33, levelReached);

    duration = (endtime - starttime2) / 1000 ;
    String elapsed2 = String(duration );
    display.drawString(96, 33, elapsed2);

    display.display();

    waitButton();

    display.clear();
    display.drawXbm(0, 0, 128, 64, titleScreenGFX);
    display.display();

    delay(500);

    waitButton();

    tone(buzzerPin, 280, 300);
    delay(300);
    tone(buzzerPin, 250, 200);
    delay(200);
    tone(buzzerPin, 370, 300);
    delay(300);
    restartGame();
  }
}

void restartGame() {
  laserX = 0;
  laserY = 0;
  laserFired = 0;
  nep = 8;
  direction = 0;
  gameOver = 0;
  bulletX = 95;
  bulletY = 0;
  bulletX2 = 95;
  bulletY2 = 0;
  bulletX3 = 95;
  bulletY3 = 0;
  points = 0;

  bulletSpeed = 3;
  bkugle = 1;
  smallest = 600;
  largest = 1200;
  diameter = 12;
  lives = 5;
  poc = 0;
  bulletFired = 0;
  level = 1;
  startTime = 0;
  selectTime = 0;
  currentTime = 0;
  levelTime = 0;
  duration = 0;
  starttime2 = 0;
  endtime = 0;
  newround = true;

  blinkXwing = false;
  blinkXwingcounter = 0;
  blinkDeathstar = false;
  blinkDeathstarcounter = 0;
}

void ledSwap() { // switch LED on when it is off, or off when it is on
  if (ledState == switchedOn) {
    ledGreenOn();
    ledState = switchedOff;
  } else {
    ledBlueOn();
    ledState = switchedOn;
  }
}

void ledsOn() { // both LEDs on
  digitalWrite(blueLed, switchedOn);      // Turn the blue LED on
  digitalWrite(greenLed, switchedOn);    // Turn the green LED on
}

void ledsOff() { // both LEDs off
  digitalWrite(blueLed, switchedOff);      // Turn the blue LED off
  digitalWrite(greenLed, switchedOff);    // Turn the green LED off
}

void ledGreenOn() { // only green LED on
  digitalWrite(blueLed, switchedOff);      // Turn the blue LED off
  digitalWrite(greenLed, switchedOn);    // Turn the green LED on
}

void ledBlueOn() { // only blue LED on
  digitalWrite(blueLed, switchedOn);      // Turn the blue LED on
  digitalWrite(greenLed, switchedOff);    // Turn the green LED off
}

void playTune() { // play the intro tune (3 notes)
  const int f = 349;
  const int a = 440;
  const int cH = 523;
  beep(a, 500);
  beep(a, 500);
  beep(a, 500);
  beep(f, 350);
  beep(cH, 150);
  beep(a, 500);
  beep(f, 350);
  beep(cH, 150);
  beep(a, 650);
}

void beep(int note, int duration) { // play a note and flash LEDs
  ledsOn();
  tone(buzzerPin, note, duration);
  delay(duration);
  ledSwap();
  noTone(buzzerPin);
  delay(50);
  ledsOff();
}

void waitButton() { // wait for button press before going to next screen, while fading LEDs
  int attractTimer = 0;
  bool countUp = true;
  while (digitalRead(buttonPush) == HIGH) {
    attractTimer = attractTimer + 10;
    if (attractTimer >= 1024) {
      attractTimer = 0;
      if (countUp == true) {
        countUp = false;
      } else {
        countUp = true;
      }
    }
    if (countUp == true) {
      analogWrite(greenLed, attractTimer);
      analogWrite(blueLed, 1024 - attractTimer);
    } else {
      analogWrite(greenLed, 1024 - attractTimer);
      analogWrite(blueLed, attractTimer);
    }
    delay(1);
  }
}
